## conf/layer.conf
```bitbake
# We have a conf and classes directory, add to BBPATH
BBPATH .= ":${LAYERDIR}"

# We have recipes-* directories, add to BBFILES
BBFILES += "${LAYERDIR}/recipes-*/*/*.bb \
            ${LAYERDIR}/recipes-*/*/*.bbappend"

BBFILE_COLLECTIONS += "meta-local-tools"
BBFILE_PATTERN_meta-local-tools = "^${LAYERDIR}/"
BBFILE_PRIORITY_meta-local-tools = "6"

LAYERDEPENDS_meta-local-tools = "core"
LAYERSERIES_COMPAT_meta-local-tools = "hardknott"

IMAGE_INSTALL_append = " python3-pyqt5"
IMAGE_INSTALL_append = " hardkey"
IMAGE_INSTALL_append = " libgpiod libgpiod-tools"
```

## conf/machine/qemuarm64-test.conf
```bitbake
#@TYPE: Machine
#@NAME: QEMU ARMv8 machine
#@DESCRIPTION: Machine configuration for running an ARMv8 system on QEMU
require conf/machine/qemuarm64.conf

#MACHINE_EXTRA_RRECOMMENDS += " kernel-modules"
KERNEL_DEVICETREE = "xilinx/zynqmp-zcu102-qemu.dtb"
KBUILD_DEFCONFIG ?= "defconfig"
KCONFIG_MODE="--alldefconfig"

QB_DTB = "/zynqmp-zcu102-qemu.dtb"
QB_AUDIO_DRV = "alsa"
QB_AUDIO_OPT = "-soundhw all"
#QB_MACHINE = "-machine xlnx-zcu102"
#QB_MACHINE = "-machine versatilepb"
#QB_NETWORK_DEVICE = "-net nic,model=virtio,macaddr=@MAC@"
IMAGE_INSTALL_append = " python3-pyqt5"
IMAGE_INSTALL_append = " hardkey"
IMAGE_INSTALL_append = " libgpiod libgpiod-tools"
IMAGE_INSTALL_append = " acpica dtc alsa-utils"
```

## conf/machine/qemux86-64-test.conf
```bitbake
#@TYPE: Machine
#@NAME: QEMU x86-64 machine
#@DESCRIPTION: Machine configuration for running an x86-64 system on QEMU
require conf/machine/qemux86-64.conf

MACHINE_EXTRA_RRECOMMENDS += " kernel-modules"
KBUILD_DEFCONFIG ?= "defconfig"
KCONFIG_MODE="--alldefconfig"
```

## conf/machine/qemux86-64.conf
```bitbake
#@TYPE: Machine
#@NAME: My QEMU x86-64 machine
#@DESCRIPTION: Machine configuration for running an x86-64 system on QEMU

require conf/machine/qemux86-64.conf


#For runqemu
PREFERRED_PROVIDER_virtual/kernel="linux-yocto"

#WKS_FILE ?= "wic/myqemu.wks"
#WKS_FILES ?= "wic/myqemu.wks"
#IMAGE_FSTYPES += "wic wic.bz2 wic.vmdk ext4"
#IMAGE_ROOTFS_SIZE = "81920"
#IMAGE_ROOTFS_EXTRA_SPACE = "8000"
#PREFERRED_PROVIDER_virtual/bootloader ?= "u-boot"
#IMAGE_BOOT_FILES ?= "u-boot.bin \
#           ${KERNEL_DEVICETREE} \
#           ${KERNEL_IMAGETYPE} \
#           "
# database
#IMAGE_INSTALL_append = " sqlite3 rauc"
#DISTRO_FEATURES += " rauc"
#COMPATIBLE_MACHINE += "myqemu"
```

## wic/myqemu.wks
```
part /boot --source bootimg-partition --ondisk mmcblk0 --fstype=vfat --label boot --active --align 4096 --size 20
part / --source rootfs --ondisk mmcblk0 --fstype=ext4 --label rootA --align 4096
part / --source rootfs --ondisk mmcblk0 --fstype=ext4 --label rootB --align 4096
```

## wic/qemux86.wks
```
#part /boot --source bootimg-pcbios --ondisk sda --label boot --active --align 1024
#part / --source rootfs --use-uuid --fstype=ext4 --label platform --align 1024

#part /boot --source bootimg-pcbios --ondisk sda --label boot --active --align 1024
#part / --source rootfs --ondisk sda --fstype=ext4 --label platform --align 1024 --use-uuid
#part /data --fixed-size 100M --ondisk sda --fstype=ext4 --label data --align 4096

part /boot --source bootimg-partition --ondisk vda --fstype=vfat --label boot --active --align 4096 --size 100
part / --source rootfs --ondisk vda --fstype=ext4 --label rootfs --align 4096 --use-uuid
part /data  --ondisk vda --fstype=ext4 --label data --align 4096 --fixed-size 1G
```
